/**
 * @file    chapter.c
 * @brief   主实验控制模块 - 重构后简洁版本
 * @details 负责初始化各模块，并提供统一入口
 * @note    所有具体实验代码已移至 experimental code 目录
 */

#include "chapter.h"
#include "h_course.h"
#include "main.h"
#include "oled.h"

/* huart2 is generated and defined in main.c; telemetry goes out on PA2 (USART2_TX)
 * so the wireless DAP probe can bridge it to the PC without touching the
 * onboard CH9102F Type-C serial. */
extern UART_HandleTypeDef huart2;

/**
 * @brief  printf 输出钩子函数
 * @param  ch: 要发送的字符
 * @retval 发送的字符
 * @note   由 GCC/CMake syscalls 调用，实现 printf 重定向到 USART2
 */
int __io_putchar(int ch) {
  uint8_t data = (uint8_t)ch;
  (void)HAL_UART_Transmit(&huart2, &data, 1U, 100U);
  return ch;
}

/**
 * @brief  全局输出使能标志（按键中断控制）
 * @note   1 = 所有模块开启，0 = 所有模块关闭
 */
volatile uint8_t outputs_requested_on = 1U;
static volatile uint8_t hcourse_start_requested;
static volatile uint32_t user_key_last_irq_tick;
static volatile uint8_t user_key_latched;
static volatile uint32_t user_key_release_low_tick;

/* PA0 is configured by CubeMX for a rising-edge USER-key interrupt. */
#define USER_KEY_DEBOUNCE_MS       100U
#define USER_KEY_RELEASE_STABLE_MS 100U

/**
 * @brief  按键中断回调：翻转所有模块开关状态
 * @param  None
 * @retval None
 * @note   在 stm32f1xx_it.c 的 HAL_GPIO_EXTI_Callback 中调用
 */
void Chapter_ToggleOutputsFromISR(void) { outputs_requested_on ^= 1U; }

void Chapter_UserKeyInterruptInit(void)
{
  /* PA0/EXTI0 mode and edge are generated by CubeMX. */
  HAL_NVIC_SetPriority(EXTI0_IRQn, 5U, 0U);
  HAL_NVIC_EnableIRQ(EXTI0_IRQn);
  hcourse_start_requested = 0U;
  user_key_last_irq_tick = HAL_GetTick() - USER_KEY_DEBOUNCE_MS;
  user_key_release_low_tick = HAL_GetTick();
  /* Do not generate a start event for a key already held at power-up. */
  user_key_latched = (HAL_GPIO_ReadPin(GPIOA, GPIO_PIN_0) == GPIO_PIN_SET) ? 1U : 0U;
}

uint8_t Chapter_ConsumeHCourseStartRequest(void)
{
  uint32_t now = HAL_GetTick();
  uint8_t requested = hcourse_start_requested;

  /* Unlock only after PA0 has remained released for a short stable interval. */
  if (user_key_latched != 0U) {
    if (HAL_GPIO_ReadPin(GPIOA, GPIO_PIN_0) == GPIO_PIN_RESET) {
      if ((now - user_key_release_low_tick) >= USER_KEY_RELEASE_STABLE_MS) {
        user_key_latched = 0U;
      }
    } else {
      user_key_release_low_tick = now;
    }
  }

  hcourse_start_requested = 0U;
  return requested;
}

void HAL_GPIO_EXTI_Callback(uint16_t GPIO_Pin)
{
  uint32_t now = HAL_GetTick();

  if ((GPIO_Pin == GPIO_PIN_0) &&
      (user_key_latched == 0U) &&
      (HAL_GPIO_ReadPin(GPIOA, GPIO_PIN_0) == GPIO_PIN_SET) &&
      ((now - user_key_last_irq_tick) >= USER_KEY_DEBOUNCE_MS)) {
    user_key_last_irq_tick = now;
    user_key_latched = 1U;
    user_key_release_low_tick = now;
    hcourse_start_requested = 1U;
  }
}

/* 按键模式状态机:按用户按键循环切换任务 */
typedef enum {
  CH_MODE_IDLE = 0,  /* 初始:静止,无任务 */
  CH_MODE_TASK1,     /* 任务1 运行中 */
  CH_MODE_TASK2,     /* 任务2 运行中 */
  CH_MODE_TASK3,     /* 任务3 运行中 */
  CH_MODE_TASK4,     /* 任务4 运行中 */
  CH_MODE_STOP1,     /* 任务1 已停止,再按进入任务2 */
  CH_MODE_STOP2,     /* 任务2 已停止,再按进入任务3 */
  CH_MODE_STOP3,     /* 任务3 已停止,再按进入任务4 */
  CH_MODE_STOP4,     /* 任务4 已停止,再按进入距离标定 */
  CH_MODE_TEST       /* 距离标定测试:跑 1 米自动停;再按回到任务1 */
} Chapter_Mode;

static Chapter_Mode ch_mode = CH_MODE_IDLE;

static void Chapter_StartTask(HCourse_Task task)
{
  HCourse_SetTask(task);
  HCourse_Start();
}

static void Chapter_HandleKey(void)
{
  switch (ch_mode) {
    case CH_MODE_IDLE:
      Chapter_StartTask(H_COURSE_TASK1_AB);
      ch_mode = CH_MODE_TASK1;
      break;
    case CH_MODE_TASK1:
      HCourse_Stop();
      ch_mode = CH_MODE_STOP1;
      break;
    case CH_MODE_STOP1:
      Chapter_StartTask(H_COURSE_TASK2_ABCD);
      ch_mode = CH_MODE_TASK2;
      break;
    case CH_MODE_TASK2:
      HCourse_Stop();
      ch_mode = CH_MODE_STOP2;
      break;
    case CH_MODE_STOP2:
      Chapter_StartTask(H_COURSE_TASK3_ACBDA);
      ch_mode = CH_MODE_TASK3;
      break;
    case CH_MODE_TASK3:
      HCourse_Stop();
      ch_mode = CH_MODE_STOP3;
      break;
    case CH_MODE_STOP3:
      Chapter_StartTask(H_COURSE_TASK4_FOUR_LAPS);
      ch_mode = CH_MODE_TASK4;
      break;
    case CH_MODE_TASK4:
      HCourse_Stop();
      ch_mode = CH_MODE_STOP4;
      break;
    case CH_MODE_STOP4:
      HCourse_DistanceTestStart();
      ch_mode = CH_MODE_TEST;
      break;
    case CH_MODE_TEST:
      HCourse_Stop();
      Chapter_StartTask(H_COURSE_TASK1_AB);
      ch_mode = CH_MODE_TASK1;
      break;
    default:
      ch_mode = CH_MODE_IDLE;
      break;
  }
}

void chapter_main(void) {
  // 2024 电赛 H 题:按键循环切换任务
  OLED_Init();
  OLED_Clear();
  OLED_ShowString(0U, 0U, "H WAIT KEY");

  /* 上电即初始化全部硬件(含 MPU6050 20 秒校准计时),但不启动任务 */
  (void)HCourse_Init(H_COURSE_TASK1_AB);
  Chapter_UserKeyInterruptInit();
  while (1) {
    if (Chapter_ConsumeHCourseStartRequest() != 0U) {
      Chapter_HandleKey();
    }

    /* 任务自然跑完 → 自动进入停止状态 */
    if (ch_mode == CH_MODE_TASK1) {
      if (HCourse_IsFinished() != 0U) {
        /* 任务代码已停车并响铃;这里只切状态,不重复 Stop(会掐断蜂鸣器) */
        ch_mode = CH_MODE_STOP1;
      }
    } else if (ch_mode == CH_MODE_TASK2) {
      if (HCourse_IsFinished() != 0U) {
        /* 同上:保留完结响铃 */
        ch_mode = CH_MODE_STOP2;
      }
    } else if (ch_mode == CH_MODE_TASK3) {
      if (HCourse_IsFinished() != 0U) {
        /* HCourse already stopped the motors; keep the final beep alive. */
        ch_mode = CH_MODE_STOP3;
      }
    } else if (ch_mode == CH_MODE_TASK4) {
      if (HCourse_IsFinished() != 0U) {
        /* 任务4 代码已停车并响铃;这里只切状态 */
        ch_mode = CH_MODE_STOP4;
      }
    }

    if (ch_mode == CH_MODE_TEST) {
      HCourse_DistanceTestPeriodic();
    } else {
      HCourse_PeriodicTask();
    }
    HCourse_UpdateOLED();
    HAL_Delay(1U);
  }
}
